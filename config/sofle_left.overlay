/*
 * SPDX-License-Identifier: MIT
 *
 * Left half I2C display configuration for Sofle.
 * Ensures the display driver initializes properly on the left half.
 * When using nice_view, this provides the I2C bus setup that the
 * nice_view adapter depends on.
 */

&i2c1 {
    status = "okay";
    clock-frequency = <I2C_BITRATE_FAST>;
    
    oled: ssd1306@3c {
        compatible = "solomon,ssd1306fb";
        reg = <0x3c>;
        width = <128>;
        height = <32>;
        segment-offset = <0>;
        page-offset = <0>;
        display-offset = <0>;
        multiplex-ratio = <31>;
        segment-remap;
        com-invdir;
        com-sequential;
        prechargep = <0x22>;
    };
};

&display {
    status = "okay";
};
